## components/lcd_cam_output/Kconfig
```kconfig
menu "pixfrog LED output"

    choice PIXFROG_LED_OUTPUT_BACKEND
        prompt "LED bus output backend"
        default PIXFROG_LED_OUTPUT_LCD_CAM
        help
            Peripheral driving the 16-bit LED bus. Both backends implement
            the same pixfrog::lcd:: interface and emit identical sample
            streams; they differ in the engine moving the bytes.

        config PIXFROG_LED_OUTPUT_LCD_CAM
            bool "LCD_CAM RGB panel"
            help
                esp_lcd RGB panel in refresh_on_demand mode. Frames are split
                into v_res lines of <=4092 samples (12-bit timing registers);
                a 3-PCLK blank separates lines, absorbed between NRZ bits.

        config PIXFROG_LED_OUTPUT_PARLIO
            bool "PARLIO TX (loop transmission)"
            help
                PARLIO TX unit in loop transmission mode: the frame is a flat
                DMA buffer repeated back-to-back (the encoded reset tail
                separates repeats), no line-geometry registers involved.
                Buffer swaps happen gapless at frame boundaries.

    endchoice

endmenu
```

## sdkconfig.defaults
```kconfig
# pixfrog default sdkconfig — tuned for ESP32-P4 + hex PSRAM + LCD_CAM + lwIP UDP
# Override with `idf.py menuconfig`; this file pins the values that matter.

#
# Target
#
CONFIG_IDF_TARGET="esp32p4"

#
# PSRAM — P4 is hex-mode only (SPIRAM_MODE_HEX, the Kconfig default).
# Speed MUST be raised from the 20 MHz default: GDMA streams the LCD frame
# buffers from PSRAM at 32 MB/s while the encoder writes the other FB, and
# at 20 MHz the LCD FIFO starves a few thousand samples into every frame
# (measured on a Saleae 2026-06). 80 MHz is the fastest non-experimental
# option on IDF v5.5 (200 MHz needs IDF_EXPERIMENTAL_FEATURES).
# NOTE: invalid symbols are dropped silently — the previous OCT/200M lines
# (S3 names) were ignored and the build ran at 20 MHz. After changing
# PSRAM options, `rm -f sdkconfig` so the defaults re-apply, and check the
# boot log line `esp_psram: Speed: 80MHz`.
#
CONFIG_SPIRAM=y
CONFIG_SPIRAM_SPEED_80M=y
CONFIG_SPIRAM_USE_MALLOC=y
CONFIG_SPIRAM_TRY_ALLOCATE_WIFI_LWIP=n
# Large allocations go to PSRAM by default; DMA buffers stay in SRAM via MALLOC_CAP_DMA.
CONFIG_SPIRAM_MALLOC_ALWAYSINTERNAL=16384

#
# CPU — 360 MHz is the P4 maximum exposed by IDF v5.5 (there is no _400
# symbol; the previous _400 line was silently dropped, same trap as the
# PSRAM options above).
#
CONFIG_ESP_DEFAULT_CPU_FREQ_MHZ_360=y
CONFIG_ESP_DEFAULT_CPU_FREQ_MHZ=360

#
# Compiler — -O2. The IDF default (-Og) costs 2-4× on the frame encoder,
# which is pure integer/store hot loops feeding the LCD_CAM DMA budget.
#
CONFIG_COMPILER_OPTIMIZATION_PERF=y

#
# Cache — 256 kB L2 (default 128 kB). The render path streams multi-hundred-kB
# frames through PSRAM every frame; a larger L2 batches the write-backs.
# Keep the 64 B line: lcd_cam_output msync-aligns to 128 B, valid for both.
#
CONFIG_CACHE_L2_CACHE_256KB=y

#
# FreeRTOS — dual-core, no tickless idle (need deterministic timing for render task)
#
CONFIG_FREERTOS_UNICORE=n
CONFIG_FREERTOS_HZ=1000
CONFIG_FREERTOS_USE_TICKLESS_IDLE=n
CONFIG_FREERTOS_CHECK_STACKOVERFLOW_CANARY=y

#
# Ethernet (PHY IP101 by default on ESP32-P4 Function EV Board)
#
CONFIG_ETH_ENABLED=y
CONFIG_ETH_USE_ESP32_EMAC=y
CONFIG_ETH_PHY_INTERFACE_RMII=y

#
# lwIP — tuned for UDP-heavy ArtNet ingest
#
CONFIG_LWIP_IPV4=y
CONFIG_LWIP_IPV6=n
CONFIG_LWIP_UDP_RECVMBOX_SIZE=32
CONFIG_LWIP_MAX_UDP_PCBS=8

#
# Logging
#
CONFIG_LOG_DEFAULT_LEVEL_INFO=y
CONFIG_LOG_COLORS=y

#
# C++
#
CONFIG_COMPILER_CXX_EXCEPTIONS=n
CONFIG_COMPILER_CXX_RTTI=n

#
# Watchdog
#
CONFIG_ESP_TASK_WDT_INIT=y
CONFIG_ESP_TASK_WDT_TIMEOUT_S=5

#
# Flash — 16 MB to fit the custom partition table below
#
CONFIG_ESPTOOLPY_FLASHSIZE_16MB=y
CONFIG_ESPTOOLPY_FLASHSIZE="16MB"

#
# Partition table — A/B OTA (ota_0/ota_1 + otadata)
#
CONFIG_PARTITION_TABLE_CUSTOM=y
CONFIG_PARTITION_TABLE_CUSTOM_FILENAME="partitions.csv"

#
# OTA — a freshly flashed image boots PENDING_VERIFY; app_main confirms it
# at boot-complete, otherwise the bootloader rolls back to the previous slot.
#
CONFIG_BOOTLOADER_APP_ROLLBACK_ENABLE=y

#
# Coredump — panics write an ELF post-mortem to the 64 KB coredump
# partition; GET /api/coredump downloads it, DELETE erases it.
#
CONFIG_ESP_COREDUMP_ENABLE_TO_FLASH=y
CONFIG_ESP_COREDUMP_DATA_FORMAT_ELF=y
CONFIG_ESP_COREDUMP_CHECKSUM_CRC32=y

#
# LED bus output backend — PARLIO TX loop transmission (also the Kconfig
# default; stated here explicitly so the choice is visible). The LCD_CAM
# backend stays buildable via the sdkconfig.ci.lcdcam overlay.
#
CONFIG_PIXFROG_LED_OUTPUT_PARLIO=y

#
# Display backend — ST7789 TFT (also the Kconfig default; stated here
# explicitly so the choice is visible). The OLED SSD1306 backend stays
# buildable via the sdkconfig.ci.oled overlay.
#
CONFIG_PIXFROG_DISPLAY_TFT=y

#
# microSD / FATFS — used by the FSEQ player.
# SDMMC host driver + FATFS VFS integration.
# format_if_mount_failed is left off; a bad SD card shows "No SD card" in the
# FSEQ menu rather than silently reformatting user data.
#
CONFIG_SOC_SDMMC_HOST_SUPPORTED=y
CONFIG_SDMMC_ENABLED=y
CONFIG_FATFS_CODEPAGE_850=y
CONFIG_FATFS_LFN_HEAP=y
CONFIG_FATFS_MAX_LFN=255
CONFIG_FATFS_VOLUME_COUNT=1
```
